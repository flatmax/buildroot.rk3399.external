## package/rockchip/drm_helper/Config.in
```kconfig
menuconfig BR2_PACKAGE_DRM_HELPER
	bool "Drm Helper"
	select BR2_PACKAGE_LIBDRM

if BR2_PACKAGE_DRM_HELPER

config BR2_PACKAGE_DRM_HELPER_ALLOCATOR
	bool "drm allocator helper"
	default y

config BR2_PACKAGE_DRM_HELPER_DISPLAY
	bool "drm display helper"
	select BR2_PACKAGE_DRM_HELPER_ALLOCATOR
	select BR2_PACKAGE_LINUX_RGA

endif
```

## package/rockchip/glmarktest/Config.in
```kconfig
config BR2_PACKAGE_GLMARKTEST
	bool "test script for glmark2"
	help
	  test script for glmark2.
```

## package/rockchip/io/Config.in
```kconfig
config BR2_PACKAGE_IO
	bool "io tool for linux"
	help
	  io tool for linux. used to read/write register, memory
```

## package/rockchip/modeset/Config.in
```kconfig
config BR2_PACKAGE_MODESET
	bool "modeset for Linux"
	depends on BR2_PACKAGE_LIBDRM
```

## package/rockchip/partinit/Config.in
```kconfig
config BR2_PACKAGE_PARTINIT
	bool "script for partition init"
	depends on BR2_PACKAGE_USBMOUNT
	help
	  script for partition init.
```

## package/rockchip/recovery/Config.in
```kconfig
config BR2_PACKAGE_RECOVERY
	bool "Rockchip recovery for linux"
        select BR2_PACKAGE_LIBDRM
        select BR2_PACKAGE_LIBPNG
        select BR2_PACKAGE_LIBPTHREAD_STUBS
        select BR2_PACKAGE_LIBZ
        select BR2_PACKAGE_DOSFSTOOLS
        select BR2_PACKAGE_DOSFSTOOLS_FSCK_FAT
        select BR2_PACKAGE_DOSFSTOOLS_MKFS_FAT
        select BR2_PACKAGE_E2FSPROGS
        select BR2_PACKAGE_E2FSPROGS_RESIZE2FS
	help
	  Rockchip recovery for linux.
```

## package/rockchip/rknpu/Config.in
```kconfig
config BR2_PACKAGE_RKNPU
	bool "rknpu"
	help
	  "Copy rknpu driver and test case"
```

## package/rockchip/rkscript/Config.in
```kconfig
config BR2_PACKAGE_RKSCRIPT
	bool "rockchip script"
	help
	  rockchip script for linux use.
```

## package/rockchip/rkwifibt/Config.in
```kconfig
menuconfig BR2_PACKAGE_RKWIFIBT
    bool "rkwifibt"

if BR2_PACKAGE_RKWIFIBT
choice
	default BR2_PACKAGE_RKWIFIBT_AWCM256
    prompt "wifi chip support"

config BR2_PACKAGE_RKWIFIBT_AP6181
    bool "AP6181"
config BR2_PACKAGE_RKWIFIBT_AP6255
    bool "AP6255"
config BR2_PACKAGE_RKWIFIBT_AP6212A1
    bool "AP6212A1"
config BR2_PACKAGE_RKWIFIBT_AP6354
    bool "AP6354"
config BR2_PACKAGE_RKWIFIBT_AP6236
    bool "AP6236"
config BR2_PACKAGE_RKWIFIBT_AWCM256
    bool "AW-CM256"
config BR2_PACKAGE_RKWIFIBT_AWNB197
    bool "AW-NAB197"
config BR2_PACKAGE_RKWIFIBT_RTL8723DS
    bool "RTL8723DS"
config BR2_PACKAGE_RKWIFIBT_RTL8189FS
    bool "RTL8189FS"
config BR2_PACKAGE_RKWIFIBT_COMPATIBLE
    bool "Rockchip Compatible with all supported wifi"
endchoice

config BR2_PACKAGE_RKWIFIBT_BTUART
	string "bt uart"
	default "ttyS4"
	depends on BR2_PACKAGE_RKWIFIBT
	help
		tty that bt used
endif
```

## package/rockchip/rockchip_modules/Config.in
```kconfig
config BR2_PACKAGE_ROCKCHIP_MODULES
    bool "rockchip modules"

if BR2_PACKAGE_ROCKCHIP_MODULES

config BR2_PACKAGE_ROCKCHIP_MODULES_EXT4
    bool "ext4 filesystem support"
config BR2_PACKAGE_ROCKCHIP_MODULES_FAT
    bool "fat filesystem support"
config BR2_PACKAGE_ROCKCHIP_MODULES_NTFS
    bool "ntfs filesystem support"
    
endif
```

## package/rockchip/rockchip_test/Config.in
```kconfig
config BR2_PACKAGE_ROCKCHIP_TEST
	bool  "stress test tools"
	select BR2_PACKAGE_STRESSAPPTEST
	select BR2_PACKAGE_DHRYSTONE
	select BR2_PACKAGE_MEMTESTER
	select BR2_PACKAGE_MEMTESTER
	select BR2_PACKAGE_BASH
	help
		function test for Rockchip stress test 
```
