## configs/neo4_custom_defconfig
```kconfig
# rockchip provided ...
BR2_TARGET_GENERIC_HOSTNAME="rk3399"
BR2_TARGET_GENERIC_ISSUE="Welcome to RK3399 Buildroot"
BR2_PACKAGE_RKWIFIBT_COMPATIBLE=y
#  - The rk3399 evb used the ttyS0 by default.
BR2_PACKAGE_RKWIFIBT_BTUART="ttyS0"

BR2_PACKAGE_SD_FUSE_RK3399=y

# neo4 specific from here on ...
BR2_TARGET_ROOTFS_EXT2_SIZE="256M"
BR2_DL_DIR="$(BASE_DIR)/../../buildroot.dl"

#BR2_TOOLCHAIN_BUILDROOT_WCHAR=y

BR2_GLOBAL_PATCH_DIR="$(BR2_EXTERNAL)/patches"

# Rock-Chip repos - mostly for sdcard image generation
BR2_PACKAGE_RKBIN=y

BR2_PACKAGE_BUSYBOX_CONFIG_FRAGMENT_FILES="$(BR2_EXTERNAL)/configs/busybox.fragment"

# uboot
BR2_TARGET_UBOOT=y
BR2_TARGET_UBOOT_BUILD_SYSTEM_KCONFIG=y
BR2_TARGET_UBOOT_CUSTOM_VERSION=y
BR2_TARGET_UBOOT_CUSTOM_VERSION_VALUE="2021.10"
BR2_TARGET_UBOOT_BOARD_DEFCONFIG="nanopi-m4-rk3399"
BR2_TARGET_UBOOT_NEEDS_DTC=y
BR2_TARGET_UBOOT_NEEDS_PYTHON3=y

BR2_TARGET_UBOOT_NEEDS_DTC=y
BR2_TARGET_UBOOT_FORMAT_BIN=y
BR2_TARGET_UBOOT_FORMAT_IMG=n
BR2_TARGET_UBOOT_SPL=n
BR2_TARGET_UBOOT_CONFIG_FRAGMENT_FILES="$(BR2_EXTERNAL)/board/nanopi-neo4/uboot.fragment"
BR2_PACKAGE_HOST_DTC=y

# Linux
BR2_LINUX_KERNEL=y
BR2_LINUX_KERNEL_USE_ARCH_DEFAULT_CONFIG=y
BR2_LINUX_KERNEL_NEEDS_HOST_OPENSSL=y
BR2_LINUX_KERNEL_DTS_SUPPORT=y
BR2_LINUX_KERNEL_DTB_OVERLAY_SUPPORT=y
BR2_LINUX_KERNEL_CONFIG_FRAGMENT_FILES="$(BR2_EXTERNAL)/board/nanopi-neo4/kernel.fragment"

BR2_LINUX_KERNEL_LATEST_VERSION=y

# change to target the M4 uncomment the following DTB
#BR2_LINUX_KERNEL_INTREE_DTS_NAME="rockchip/rk3399-nanopi-m4"
# change target to the M4B uncomment the following DTB
BR2_LINUX_KERNEL_INTREE_DTS_NAME="rockchip/rk3399-nanopi-m4b"

# package options
BR2_PACKAGE_FFTW_USE_NEON=y
BR2_PACKAGE_EIGEN_UNSUPPORTED_MODULES=y

# buildroot packages

# wifi
#BR2_PACKAGE_WPA_SUPPLICANT=y
#BR2_PACKAGE_RPI_WIFI_FIRMWARE=y
#BR2_PACKAGE_RPI_FIRMWARE_INSTALL_DTB_OVERLAYS=y
# wifi and bluetooth
BR2_PACKAGE_ARMBIAN_FIRMWARE=y
BR2_PACKAGE_ARMBIAN_FIRMWARE_AP6256=y

# setup options
BR2_ROOTFS_OVERLAY="$(BR2_EXTERNAL)/overlays"
BR2_ROOTFS_USERS_TABLES="$(BR2_EXTERNAL)/users.txt"

BR2_PACKAGE_HOST_GENIMAGE=y
BR2_PACKAGE_HOST_MTOOLS=y
BR2_ROOTFS_POST_IMAGE_SCRIPT="$(BR2_EXTERNAL)/board/nanopi-neo4/post-image.sh"
BR2_ROOTFS_POST_SCRIPT_ARGS=""
BR2_ROOTFS_POST_BUILD_SCRIPT=""

# external packages
BR2_PACKAGE_NTP=y
BR2_PACKAGE_NTP_NTPDATE=y

#BR2_PACKAGE_LINUX_PAM=y
BR2_PACKAGE_OPENSSH=y
BR2_PACKAGE_OPENSSH_SERVER=y
BR2_PACKAGE_OPENSSH_CLIENT=y
BR2_SYSTEM_DHCP="eth0"
BR2_PACKAGE_AVAHI=y
BR2_PACKAGE_AVAHI_DAEMON=y

# Audio
BR2_PACKAGE_ALSA_UTILS=y
BR2_PACKAGE_ALSA_UTILS_ALSAMIXER=y
BR2_PACKAGE_ALSA_UTILS_AMIXER=y
BR2_PACKAGE_ALSA_UTILS_APLAY=y
BR2_PACKAGE_ALSA_UTILS_ALSACTL=y

# weston : enable these to auto launch weston
BR2_PACKAGE_NANOPI_SCRIPTS=y
BR2_PACKAGE_NANOPI_SCRIPTS_INIT_WESTON=y

BR2_PACKAGE_EXAMPLE_MODULE_OVERLAY=y
BR2_PACKAGE_DUMMY_SOUNDCARD=y

# webengine : from configs/raspberrypi3_qt5we_defconfig
#BR2_PACKAGE_LIBERATION=y
#BR2_PACKAGE_QT5=y
#BR2_PACKAGE_QT5BASE_EXAMPLES=y
#BR2_PACKAGE_QT5BASE_GIF=y
#BR2_PACKAGE_QT5BASE_JPEG=y
#BR2_PACKAGE_QT5BASE_PNG=y
#BR2_PACKAGE_QT5WEBENGINE=y
#BR2_PACKAGE_QT5WEBENGINE_PROPRIETARY_CODECS=y
#BR2_PACKAGE_QT5WEBENGINE_ALSA=y
#BR2_PACKAGE_CA_CERTIFICATES=y
# webengine browser
#BR2_PACKAGE_QT5WEBVIEW=y
```

## package/Config.in
```kconfig
menu "Packages"
source "$BR2_EXTERNAL_NEO4_PATH/package/gtkiostream/Config.in"
source "$BR2_EXTERNAL_NEO4_PATH/package/sd-fuse-rk3399/Config.in"
source "$BR2_EXTERNAL_NEO4_PATH/package/rockchip/Config.in"
#source "$BR2_EXTERNAL_NEO4_PATH/package/rockchip/bluez-alsa/Config.in"

source "$BR2_EXTERNAL_NEO4_PATH/package/libmali/Config.in"
source "$BR2_EXTERNAL_NEO4_PATH/package/nanopi_scripts/Config.in"
endmenu

# menuconfig BR2_PACKAGE_ROCKCHIP
# 	bool "rockchip BSP packages"
#
# if BR2_PACKAGE_ROCKCHIP
# choice
# 	default BR2_PACKAGE_RV1108
# 	prompt "rockchip chip support"
#
# config BR2_PACKAGE_RV1108
# 	bool "rv1108 chip"
# 	help
# 		Use rockchip's rv1108 chip
#
# config BR2_PACKAGE_RK312X
# 	bool "rk312X chip"
# 	help
# 		Use rockchip's rk312x chip
#
# config BR2_PACKAGE_RK3036_ECHO
# 	bool "rk3036G chip"
# 	help
# 		Use rockchip's rk3036g chip
#
# config BR2_PACKAGE_RK3308
#     bool "rk3308 chip"
#     help
#         Use rockchip's rk3308 chip
#
# config BR2_PACKAGE_RK3128H
#     bool "rk3128H chip"
#     help
#         Use rockchip's rk3128H box chip
#
# config BR2_PACKAGE_RK3128
#     bool "rk3128 chip"
#     help
#         Use rockchip's rk3128 chip
#
# config BR2_PACKAGE_RK3399
#     bool "rk3399 chip"
#     help
#         Use rockchip's rk3399 chip
#
# config BR2_PACKAGE_RK3288
#     bool "rk3288 chip"
#     help
#         Use rockchip's rk3288 chip
#
# config BR2_PACKAGE_RK3326
#     bool "rk3326 chip"
#     help
#         Use rockchip's rk3326 chip
#
# config BR2_PACKAGE_PX30
#     bool "px30 chip"
#     help
#         Use rockchip's px30 chip
#
# config BR2_PACKAGE_PX3SE
#     bool "px3se chip"
#     help
#         Use rockchip's px3se chip
#
# config BR2_PACKAGE_RK1808
#     bool "rk1808 chip"
#     help
#         Use rockchip's rk1808 chip
#
# config BR2_PACKAGE_RK3399PRO_NPU
#     bool "rk3399pro npu chip"
#     help
#         Use rockchip's rk3399pro npu chip
#
# config BR2_PACKAGE_RK3328
#     bool "rk3328 chip"
#     help
#         Use rockchip's rk3328 chip
#
# config BR2_PACKAGE_RK3229
#     bool "rk3229 chip"
#     help
#         Use rockchip's rk3229 chip
#
# config BR2_PACKAGE_RK3036
#     bool "rk3036 chip"
#     help
#         Use rockchip's rk3036 chip
#
# endchoice
# endif
```

## package/dummy-soundcard/module-dummy-soundcard/Kconfig
```kconfig
config SND_SOC_DUMMY_SOUNDCARD
        tristate "RK33xx platform machine driver example for a dummy soundcard"
        select SND_SOC_PCM5102A
        default n
        help
          ALSA machine driver for a dummy soundcard
```

## package/example-module-overlay/module-overlay-rk33xx/Kconfig
```kconfig
config SND_SOC_MODULE_OVERLAY_RK33xx
        tristate "RK33xx platform machine driver example"
        select SND_SOC_WM8731
        default n
        help
          Audio Injector ALSA machine driver for the rk33xx (e.g. RockPi s) platform.
```

## package/libmali/Config.in
```kconfig
config BR2_PACKAGE_LIBMALI
	bool "rockchip libmali"
	depends on BR2_TOOLCHAIN_USES_GLIBC
	select BR2_PACKAGE_HAS_LIBEGL
	select BR2_PACKAGE_HAS_LIBGLES
	help
	  Install the binary user-space library for the ARM Mali GPU.
	  This package requires a kernel with the ARM Mali GPU Kernel
	  Drivers enabled.
```

## package/nanopi_scripts/Config.in
```kconfig
config BR2_PACKAGE_NANOPI_SCRIPTS
        bool "nanopi scripts"
	help
		Nanopi scripts

config BR2_PACKAGE_NANOPI_SCRIPTS_INIT_WESTON
	bool "nanopi scripts init weston"
	select BR2_PACKAGE_LIBMALI
	select BR2_PACKAGE_MESA3D
	select BR2_PACKAGE_MESA3D_GALLIUM_DRIVER_SWRAST
	select BR2_PACKAGE_MESA3D_OPENGL_EGL
	select BR2_PACKAGE_MESA3D_OPENGL_ES
	select BR2_PACKAGE_WAYLAND
	select BR2_PACKAGE_WESTON
	select BR2_PACKAGE_WESTON_DRM
	select BR2_PACKAGE_MPP
	select BR2_PACKAGE_MPP_ALLOCATOR_DRM
	select BR2_PACKAGE_LINUX_RGA
	help
	  Autostart weston
```

## package/rockchip/Config.in
```kconfig
menuconfig BR2_PACKAGE_ROCKCHIP
	bool "rockchip BSP packages"

if BR2_PACKAGE_ROCKCHIP
choice
	default BR2_PACKAGE_RV1108
	prompt "rockchip chip support"

config BR2_PACKAGE_RV1108
	bool "rv1108 chip"
	help
		Use rockchip's rv1108 chip

config BR2_PACKAGE_RK312X
	bool "rk312X chip"
	help
		Use rockchip's rk312x chip

config BR2_PACKAGE_RK3036_ECHO
	bool "rk3036G chip"
	help
		Use rockchip's rk3036g chip

config BR2_PACKAGE_RK3308
    bool "rk3308 chip"
    help
        Use rockchip's rk3308 chip

config BR2_PACKAGE_RK3128H
    bool "rk3128H chip"
    help
        Use rockchip's rk3128H box chip

config BR2_PACKAGE_RK3128
    bool "rk3128 chip"
    help
        Use rockchip's rk3128 chip

config BR2_PACKAGE_RK3399
    bool "rk3399 chip"
    help
        Use rockchip's rk3399 chip

config BR2_PACKAGE_RK3288
    bool "rk3288 chip"
    help
        Use rockchip's rk3288 chip

config BR2_PACKAGE_RK3326
    bool "rk3326 chip"
    help
        Use rockchip's rk3326 chip

config BR2_PACKAGE_PX30
    bool "px30 chip"
    help
        Use rockchip's px30 chip

config BR2_PACKAGE_PX3SE
    bool "px3se chip"
    help
        Use rockchip's px3se chip

config BR2_PACKAGE_RK1808
    bool "rk1808 chip"
    help
        Use rockchip's rk1808 chip

config BR2_PACKAGE_RK3399PRO_NPU
    bool "rk3399pro npu chip"
    help
        Use rockchip's rk3399pro npu chip

config BR2_PACKAGE_RK3328
    bool "rk3328 chip"
    help
        Use rockchip's rk3328 chip

config BR2_PACKAGE_RK3229
    bool "rk3229 chip"
    help
        Use rockchip's rk3229 chip

config BR2_PACKAGE_RK3036
    bool "rk3036 chip"
    help
        Use rockchip's rk3036 chip

endchoice



# BSP packages
source "$BR2_EXTERNAL_NEO4_PATH/package/rockchip/rv1108-firmware/Config.in"

# Shared packages with all chips
source "$BR2_EXTERNAL_NEO4_PATH/package/rockchip/ros/Config.in"
source "$BR2_EXTERNAL_NEO4_PATH/package/rockchip/liblog/Config.in"
source "$BR2_EXTERNAL_NEO4_PATH/package/rockchip/LocalPlayer/Config.in"
source "$BR2_EXTERNAL_NEO4_PATH/package/rockchip/alexaClientSDK/Config.in"
source "$BR2_EXTERNAL_NEO4_PATH/package/rockchip/DuerClientSDK/Config.in"
source "$BR2_EXTERNAL_NEO4_PATH/package/rockchip/libcutils/Config.in"
source "$BR2_EXTERNAL_NEO4_PATH/package/rockchip/drm_helper/Config.in"
source "$BR2_EXTERNAL_NEO4_PATH/package/rockchip/mpp/Config.in"
source "$BR2_EXTERNAL_NEO4_PATH/package/rockchip/adbd/Config.in"
source "$BR2_EXTERNAL_NEO4_PATH/package/rockchip/gstreamer1-rockchip/Config.in"
source "$BR2_EXTERNAL_NEO4_PATH/package/rockchip/gstreamer1-rockchip-extra/Config.in"
source "$BR2_EXTERNAL_NEO4_PATH/package/rockchip/camera_engine_rkisp/Config.in"
source "$BR2_EXTERNAL_NEO4_PATH/package/rockchip/camera_engine_cifisp/Config.in"
source "$BR2_EXTERNAL_NEO4_PATH/package/rockchip/wakeWordAgent/Config.in"
source "$BR2_EXTERNAL_NEO4_PATH/package/rockchip/pcba/Config.in"
source "$BR2_EXTERNAL_NEO4_PATH/package/rockchip/softap/Config.in"
source "$BR2_EXTERNAL_NEO4_PATH/package/rockchip/softapServer/Config.in"
source "$BR2_EXTERNAL_NEO4_PATH/package/rockchip/wifiAutoSetup/Config.in"
source "$BR2_EXTERNAL_NEO4_PATH/package/rockchip/gstreamer1-iep/Config.in"
source "$BR2_EXTERNAL_NEO4_PATH/package/rockchip/gst1-libav-rk/Config.in"
source "$BR2_EXTERNAL_NEO4_PATH/package/rockchip/rkwifibt/Config.in"
source "$BR2_EXTERNAL_NEO4_PATH/package/rockchip/rockchip_utils/Config.in"
source "$BR2_EXTERNAL_NEO4_PATH/package/rockchip/mdev_mount/Config.in"
source "$BR2_EXTERNAL_NEO4_PATH/package/rockchip/alsa_capture/Config.in"
source "$BR2_EXTERNAL_NEO4_PATH/package/rockchip/libmali/Config.in"
source "$BR2_EXTERNAL_NEO4_PATH/package/rockchip/libhdmiset/Config.in"
source "$BR2_EXTERNAL_NEO4_PATH/package/rockchip/dialserver/Config.in"
source "$BR2_EXTERNAL_NEO4_PATH/package/rockchip/linux-rga/Config.in"
source "$BR2_EXTERNAL_NEO4_PATH/package/rockchip/iflytekSDK/Config.in"
source "$BR2_EXTERNAL_NEO4_PATH/package/rockchip/eq_drc_process/Config.in"
source "$BR2_EXTERNAL_NEO4_PATH/package/rockchip/alsa_ladspa/Config.in"
source "$BR2_EXTERNAL_NEO4_PATH/package/rockchip/rockchip_test/Config.in"
source "$BR2_EXTERNAL_NEO4_PATH/package/rockchip/rockchip_modules/Config.in"
source "$BR2_EXTERNAL_NEO4_PATH/package/rockchip/broadcom_bsa/Config.in"
source "$BR2_EXTERNAL_NEO4_PATH/package/rockchip/cypress_bsa/Config.in"
source "$BR2_EXTERNAL_NEO4_PATH/package/rockchip/pm-suspend-api/Config.in"
source "$BR2_EXTERNAL_NEO4_PATH/package/rockchip/rtw_simple_config/Config.in"
source "$BR2_EXTERNAL_NEO4_PATH/package/rockchip/recovery/Config.in"
source "$BR2_EXTERNAL_NEO4_PATH/package/rockchip/update/Config.in"
source "$BR2_EXTERNAL_NEO4_PATH/package/rockchip/modeset/Config.in"
source "$BR2_EXTERNAL_NEO4_PATH/package/rockchip/rkjpeg/Config.in"
source "$BR2_EXTERNAL_NEO4_PATH/package/rockchip/jpegdemo/Config.in"
source "$BR2_EXTERNAL_NEO4_PATH/package/rockchip/ueventd/Config.in"
source "$BR2_EXTERNAL_NEO4_PATH/package/rockchip/rkupdate/Config.in"
source "$BR2_EXTERNAL_NEO4_PATH/package/rockchip/io/Config.in"
source "$BR2_EXTERNAL_NEO4_PATH/package/rockchip/music/Config.in"
source "$BR2_EXTERNAL_NEO4_PATH/package/rockchip/video/Config.in"
source "$BR2_EXTERNAL_NEO4_PATH/package/rockchip/camera/Config.in"
source "$BR2_EXTERNAL_NEO4_PATH/package/rockchip/carmachine/Config.in"
source "$BR2_EXTERNAL_NEO4_PATH/package/rockchip/gallery/Config.in"
source "$BR2_EXTERNAL_NEO4_PATH/package/rockchip/QLauncher/Config.in"
source "$BR2_EXTERNAL_NEO4_PATH/package/rockchip/settings/Config.in"
source "$BR2_EXTERNAL_NEO4_PATH/package/rockchip/powermanager/Config.in"
source "$BR2_EXTERNAL_NEO4_PATH/package/rockchip/audioservice/Config.in"
source "$BR2_EXTERNAL_NEO4_PATH/package/rockchip/securityAuth/Config.in"
source "$BR2_EXTERNAL_NEO4_PATH/package/rockchip/recoverySystem/Config.in"
source "$BR2_EXTERNAL_NEO4_PATH/package/rockchip/led_control_app/Config.in"
source "$BR2_EXTERNAL_NEO4_PATH/package/rockchip/cae_vad/Config.in"
source "$BR2_EXTERNAL_NEO4_PATH/package/rockchip/ipc_share_memory/Config.in"
source "$BR2_EXTERNAL_NEO4_PATH/package/rockchip/rk_hw_vad/Config.in"
source "$BR2_EXTERNAL_NEO4_PATH/package/rockchip/usbdevice/Config.in"
source "$BR2_EXTERNAL_NEO4_PATH/package/rockchip/minigui/Config.in"
source "$BR2_EXTERNAL_NEO4_PATH/package/rockchip/libpng12/Config.in"
source "$BR2_EXTERNAL_NEO4_PATH/package/rockchip/kernel_modules/Config.in"
source "$BR2_EXTERNAL_NEO4_PATH/package/rockchip/vendor_storage/Config.in"
source "$BR2_EXTERNAL_NEO4_PATH/package/rockchip/partinit/Config.in"
source "$BR2_EXTERNAL_NEO4_PATH/package/rockchip/glmarktest/Config.in"
source "$BR2_EXTERNAL_NEO4_PATH/package/rockchip/tensorflow/Config.in"
source "$BR2_EXTERNAL_NEO4_PATH/package/rockchip/rknpu/Config.in"
source "$BR2_EXTERNAL_NEO4_PATH/package/rockchip/mtp/Config.in"
source "$BR2_EXTERNAL_NEO4_PATH/package/rockchip/alsa-config/Config.in"
source "$BR2_EXTERNAL_NEO4_PATH/package/rockchip/libcapsimage/Config.in"
source "$BR2_EXTERNAL_NEO4_PATH/package/rockchip/rkscript/Config.in"
source "$BR2_EXTERNAL_NEO4_PATH/package/rockchip/deviceio/Config.in"
source "$BR2_EXTERNAL_NEO4_PATH/package/rockchip/ble_wificonfig/Config.in"
endif
```

## package/rockchip/QLauncher/Config.in
```kconfig
config BR2_PACKAGE_QLAUNCHER
	bool "QLauncher"
	depends on BR2_PACKAGE_QT5
	help
	  Rockchip QLauncher application based on QT
```

## package/rockchip/broadcom_bsa/Config.in
```kconfig
config BR2_PACKAGE_BROADCOM_BSA
    bool "broadcom(ampak) bsa server and app"
    help
	broadcom bsa server and app
if BR2_PACKAGE_BROADCOM_BSA
choice
	default BR2_PACKAGE_BROADCOM_BSA_AP6255
    prompt "wifi/bt chip support"

	config BR2_PACKAGE_BROADCOM_BSA_AP6255
		bool "AP6255"
	config BR2_PACKAGE_BROADCOM_BSA_AP6212A1
		bool "AP6212A1"
	config BR2_PACKAGE_BROADCOM_BSA_AP6354
		bool "AP6354"
endchoice
endif
```

## package/rockchip/camera_engine_rkisp/Config.in
```kconfig
config BR2_PACKAGE_CAMERA_ENGINE_RKISP
	bool "Rockchip Camera Engine for linux"
	help
	  Rockchip camera engine for linux.
```

## package/rockchip/cypress_bsa/Config.in
```kconfig
config BR2_PACKAGE_CYPRESS_BSA
    bool "broadcom(cypress) bsa server and app"
    help
	broadcom bsa server and app
if BR2_PACKAGE_CYPRESS_BSA
choice
	default BR2_PACKAGE_CYPRESS_BSA_AWCM256
    prompt "wifi/bt chip support"

	config BR2_PACKAGE_CYPRESS_BSA_AWCM256
		bool "AW-CM256"
	config BR2_PACKAGE_CYPRESS_BSA_AWNB197
		bool "AW-NB197"
endchoice
endif
```

## package/rockchip/deviceio/Config.in
```kconfig
config BR2_PACKAGE_DEVICEIO
	bool "basic device io library"
	select BR2_PACKAGE_ALSA_LIB
```
