## package/rockchip/ros/Config.in
```kconfig
menuconfig BR2_PACKAGE_ROS_SUPPORT_SET
	bool "ros BSP package"
    depends on BR2_PACKAGE_PYTHON
    depends on BR2_PACKAGE_BOOST

if BR2_PACKAGE_ROS_SUPPORT_SET
choice
	default BR2_PACKAGE_ROS_INDIGO
	prompt "ros package support"

config BR2_PACKAGE_ROS_KINETIC
	bool "kinetic"
	help
		used ros with version kinetic

config BR2_PACKAGE_ROS_INDIGO
	bool "indigo"
	help
		used ros with version indigo

endchoice
source "$BR2_EXTERNAL_NEO4_PATH/package/rockchip/ros/geometry2/Config.in"
source "$BR2_EXTERNAL_NEO4_PATH/package/rockchip/ros/vision-opencv/Config.in"

source "$BR2_EXTERNAL_NEO4_PATH/package/rockchip/ros/dynamic-reconfigure/Config.in"
source "$BR2_EXTERNAL_NEO4_PATH/package/rockchip/ros/actionlib/Config.in"
source "$BR2_EXTERNAL_NEO4_PATH/package/rockchip/ros/ros-comm/Config.in"
source "$BR2_EXTERNAL_NEO4_PATH/package/rockchip/ros/python-ros/Config.in"
source "$BR2_EXTERNAL_NEO4_PATH/package/rockchip/ros/common-msgs/Config.in"
source "$BR2_EXTERNAL_NEO4_PATH/package/rockchip/ros/roscpp-core/Config.in"
source "$BR2_EXTERNAL_NEO4_PATH/package/rockchip/ros/ros/Config.in"
source "$BR2_EXTERNAL_NEO4_PATH/package/rockchip/ros/ros-comm-msgs/Config.in"
source "$BR2_EXTERNAL_NEO4_PATH/package/rockchip/ros/geometry/Config.in"
source "$BR2_EXTERNAL_NEO4_PATH/package/rockchip/ros/catkin/Config.in.host"
source "$BR2_EXTERNAL_NEO4_PATH/package/rockchip/ros/catkin/Config.in"
source "$BR2_EXTERNAL_NEO4_PATH/package/rockchip/ros/pluginlib/Config.in"
source "$BR2_EXTERNAL_NEO4_PATH/package/rockchip/ros/message-runtime/Config.in"
source "$BR2_EXTERNAL_NEO4_PATH/package/rockchip/ros/console-bridge/Config.in"
source "$BR2_EXTERNAL_NEO4_PATH/package/rockchip/ros/gencpp/Config.in"
source "$BR2_EXTERNAL_NEO4_PATH/package/rockchip/ros/genlisp/Config.in"
source "$BR2_EXTERNAL_NEO4_PATH/package/rockchip/ros/genmsg/Config.in"
source "$BR2_EXTERNAL_NEO4_PATH/package/rockchip/ros/genpy/Config.in"
source "$BR2_EXTERNAL_NEO4_PATH/package/rockchip/ros/angles/Config.in"
source "$BR2_EXTERNAL_NEO4_PATH/package/rockchip/ros/class-loader/Config.in"
source "$BR2_EXTERNAL_NEO4_PATH/package/rockchip/ros/cmake_modules/Config.in"
source "$BR2_EXTERNAL_NEO4_PATH/package/rockchip/ros/rospack/Config.in"
source "$BR2_EXTERNAL_NEO4_PATH/package/rockchip/ros/orocos_kinematics_dynamics/Config.in"

if BR2_PACKAGE_ROS_KINETIC
source "$BR2_EXTERNAL_NEO4_PATH/package/rockchip/ros/std-msgs/Config_kinetic.in"
source "$BR2_EXTERNAL_NEO4_PATH/package/rockchip/ros/message-generation/Config_kinetic.in"
source "$BR2_EXTERNAL_NEO4_PATH/package/rockchip/ros/geneus/Config.in"
source "$BR2_EXTERNAL_NEO4_PATH/package/rockchip/ros/gennodejs/Config.in"
source "$BR2_EXTERNAL_NEO4_PATH/package/rockchip/ros/bond-core/Config.in"
source "$BR2_EXTERNAL_NEO4_PATH/package/rockchip/ros/nodelet-core/Config.in"
source "$BR2_EXTERNAL_NEO4_PATH/package/rockchip/ros/image-common/Config.in"
source "$BR2_EXTERNAL_NEO4_PATH/package/rockchip/ros/libuvc/Config.in"
source "$BR2_EXTERNAL_NEO4_PATH/package/rockchip/ros/libuvc-ros/Config.in"

endif

if BR2_PACKAGE_ROS_INDIGO
source "$BR2_EXTERNAL_NEO4_PATH/package/rockchip/ros/std-msgs/Config_indigo.in"
source "$BR2_EXTERNAL_NEO4_PATH/package/rockchip/ros/message-generation/Config_indigo.in"

endif

endif
```

## package/rockchip/ros/common-msgs/geometry-msgs/Config.in
```kconfig
config BR2_PACKAGE_GEOMETRY_MSGS
    bool "geometry-msgs"
    help
        geometry-msgs provides messages for common geometric primitives
        such as points, vectors, and poses
```

## package/rockchip/ros/geometry/Config.in
```kconfig
menuconfig BR2_PACKAGE_GEOMETRY_SET
    bool "geometry"
    depends on BR2_PACKAGE_HOST_CATKIN

if BR2_PACKAGE_GEOMETRY_SET
source "$BR2_EXTERNAL_NEO4_PATH/package/rockchip/ros/geometry/eigen-conversions/Config.in"
source "$BR2_EXTERNAL_NEO4_PATH/package/rockchip/ros/geometry/tf/Config.in"
source "$BR2_EXTERNAL_NEO4_PATH/package/rockchip/ros/geometry/geometry/Config.in"
source "$BR2_EXTERNAL_NEO4_PATH/package/rockchip/ros/geometry/kdl-conversions/Config.in"
source "$BR2_EXTERNAL_NEO4_PATH/package/rockchip/ros/geometry/tf-conversions/Config.in"
endif
```

## package/rockchip/ros/image-common/Config.in
```kconfig
menuconfig BR2_PACKAGE_IMAGE_COMMON_SET
	bool "image_common"
	depends on BR2_PACKAGE_HOST_CATKIN
	depends on BR2_PACKAGE_BOOST

if BR2_PACKAGE_IMAGE_COMMON_SET
source "$BR2_EXTERNAL_NEO4_PATH/package/rockchip/ros/image-common/image-common/Config.in"
source "$BR2_EXTERNAL_NEO4_PATH/package/rockchip/ros/image-common/image-transport/Config.in"
source "$BR2_EXTERNAL_NEO4_PATH/package/rockchip/ros/image-common/camera-calibration-parsers/Config.in"
source "$BR2_EXTERNAL_NEO4_PATH/package/rockchip/ros/image-common/camera-info-manager/Config.in"
endif
```

## package/rockchip/ros/libuvc/Config.in
```kconfig
config BR2_PACKAGE_LIBUVC
	bool
	depends on BR2_PACKAGE_BOOST
	depends on BR2_PACKAGE_HOST_CATKIN
	depends on BR2_PACKAGE_CV_BRIDGE
	depends on BR2_PACKAGE_JPEG
	select BR2_PACKAGE_LIBUSB
	help
		libuvc
```

## package/rockchip/ros/nodelet-core/Config.in
```kconfig
menuconfig BR2_PACKAGE_NODELET_CORE_SET
	bool "ros nodelet-core"
	depends on BR2_PACKAGE_HOST_CATKIN

if BR2_PACKAGE_NODELET_CORE_SET
source "$BR2_EXTERNAL_NEO4_PATH/package/rockchip/ros/nodelet-core/nodelet/Config.in"
source "$BR2_EXTERNAL_NEO4_PATH/package/rockchip/ros/nodelet-core/nodelet-core/Config.in"
source "$BR2_EXTERNAL_NEO4_PATH/package/rockchip/ros/nodelet-core/test-nodelet/Config.in"
source "$BR2_EXTERNAL_NEO4_PATH/package/rockchip/ros/nodelet-core/nodelet-topic-tools/Config.in"
source "$BR2_EXTERNAL_NEO4_PATH/package/rockchip/ros/nodelet-core/test-nodelet-topic-tools/Config.in"
endif
```

## package/rockchip/ros/orocos_kinematics_dynamics/Config.in
```kconfig
source "$BR2_EXTERNAL_NEO4_PATH/package/rockchip/ros/orocos_kinematics_dynamics/orocos-kdl/Config.in"
```

## package/rockchip/ros/python-ros/python-catkin_pkg/Config.in.host
```kconfig
config BR2_PACKAGE_HOST_PYTHON_CATKIN_PKG
	bool "host catkin_pkg for ROS"
	help
		Standalone Python library for the catkin build system
```

## package/rockchip/ros/ros-comm/Config.in
```kconfig
menuconfig BR2_PACKAGE_ROS_COMM_SET
    bool "ros ros-comm"
    depends on BR2_PACKAGE_HOST_CATKIN

if BR2_PACKAGE_ROS_COMM_SET
source "$BR2_EXTERNAL_NEO4_PATH/package/rockchip/ros/ros-comm/ros-comm/Config.in"
source "$BR2_EXTERNAL_NEO4_PATH/package/rockchip/ros/ros-comm/roswtf/Config.in"
source "$BR2_EXTERNAL_NEO4_PATH/package/rockchip/ros/ros-comm/rospy/Config.in"
source "$BR2_EXTERNAL_NEO4_PATH/package/rockchip/ros/ros-comm/rostopic/Config.in"
source "$BR2_EXTERNAL_NEO4_PATH/package/rockchip/ros/ros-comm/rosout/Config.in"
source "$BR2_EXTERNAL_NEO4_PATH/package/rockchip/ros/ros-comm/rosnode/Config.in"
source "$BR2_EXTERNAL_NEO4_PATH/package/rockchip/ros/ros-comm/rosservice/Config.in"
source "$BR2_EXTERNAL_NEO4_PATH/package/rockchip/ros/ros-comm/rosparam/Config.in"
source "$BR2_EXTERNAL_NEO4_PATH/package/rockchip/ros/ros-comm/rosgraph/Config.in"
source "$BR2_EXTERNAL_NEO4_PATH/package/rockchip/ros/ros-comm/rosmaster/Config.in"
source "$BR2_EXTERNAL_NEO4_PATH/package/rockchip/ros/ros-comm/rosmsg/Config.in"
source "$BR2_EXTERNAL_NEO4_PATH/package/rockchip/ros/ros-comm/roslaunch/Config.in"
source "$BR2_EXTERNAL_NEO4_PATH/package/rockchip/ros/ros-comm/rosbag/Config.in"
source "$BR2_EXTERNAL_NEO4_PATH/package/rockchip/ros/ros-comm/rosbag-storage/Config.in"
source "$BR2_EXTERNAL_NEO4_PATH/package/rockchip/ros/ros-comm/roslz4/Config.in"
source "$BR2_EXTERNAL_NEO4_PATH/package/rockchip/ros/ros-comm/message-filters/Config.in"
source "$BR2_EXTERNAL_NEO4_PATH/package/rockchip/ros/ros-comm/roscpp/Config.in"
source "$BR2_EXTERNAL_NEO4_PATH/package/rockchip/ros/ros-comm/rosconsole/Config.in"
source "$BR2_EXTERNAL_NEO4_PATH/package/rockchip/ros/ros-comm/rostest/Config.in"
source "$BR2_EXTERNAL_NEO4_PATH/package/rockchip/ros/ros-comm/xmlrpcpp/Config.in"
source "$BR2_EXTERNAL_NEO4_PATH/package/rockchip/ros/ros-comm/topic-tools/Config.in"

endif
```

## package/rockchip/ros/ros/Config.in
```kconfig
menuconfig BR2_PACKAGE_ROS_SET
    bool "ros"
    depends on BR2_PACKAGE_HOST_CATKIN
    depends on BR2_PACKAGE_PYTHON

if BR2_PACKAGE_ROS_SET
source "$BR2_EXTERNAL_NEO4_PATH/package/rockchip/ros/ros/mk/Config.in"
source "$BR2_EXTERNAL_NEO4_PATH/package/rockchip/ros/ros/ros/Config.in"
source "$BR2_EXTERNAL_NEO4_PATH/package/rockchip/ros/ros/rosbash/Config.in"
source "$BR2_EXTERNAL_NEO4_PATH/package/rockchip/ros/ros/rosboost-cfg/Config.in"
source "$BR2_EXTERNAL_NEO4_PATH/package/rockchip/ros/ros/rosbuild/Config.in"
source "$BR2_EXTERNAL_NEO4_PATH/package/rockchip/ros/ros/rosclean/Config.in"
source "$BR2_EXTERNAL_NEO4_PATH/package/rockchip/ros/ros/roscreate/Config.in"
source "$BR2_EXTERNAL_NEO4_PATH/package/rockchip/ros/ros/roslang/Config.in"
source "$BR2_EXTERNAL_NEO4_PATH/package/rockchip/ros/ros/roslib/Config.in"
source "$BR2_EXTERNAL_NEO4_PATH/package/rockchip/ros/ros/rosmake/Config.in"
source "$BR2_EXTERNAL_NEO4_PATH/package/rockchip/ros/ros/rosunit/Config.in"

endif
```

## package/rockchip/ros/roscpp-core/Config.in
```kconfig
menuconfig BR2_PACKAGE_ROSCPP_CORE_SET
    bool "roscpp-core"
    depends on BR2_PACKAGE_HOST_CATKIN

if BR2_PACKAGE_ROSCPP_CORE_SET
source "$BR2_EXTERNAL_NEO4_PATH/package/rockchip/ros/roscpp-core/cpp_common/Config.in"
source "$BR2_EXTERNAL_NEO4_PATH/package/rockchip/ros/roscpp-core/roscpp_core/Config.in"
source "$BR2_EXTERNAL_NEO4_PATH/package/rockchip/ros/roscpp-core/roscpp_serialization/Config.in"
source "$BR2_EXTERNAL_NEO4_PATH/package/rockchip/ros/roscpp-core/roscpp_traits/Config.in"
source "$BR2_EXTERNAL_NEO4_PATH/package/rockchip/ros/roscpp-core/rostime/Config.in"

endif
```

## package/rockchip/rv1108-firmware/Config.in
```kconfig
config BR2_PACKAGE_RV1108_FIRMWARE
	bool "rv1108 firmware"
	depends on BR2_PACKAGE_RV1108
```

## package/rockchip/update/Config.in
```kconfig
config BR2_PACKAGE_UPDATE
	bool "Rockchip OTA update for linux"
	help
	  Rockchip OTA update for linux. it is just command without UI.
```

## package/rockchip/usbdevice/Config.in
```kconfig
config BR2_PACKAGE_USBDEVICE
	bool "script for USB device configure"
	depends on BR2_ROOTFS_DEVICE_CREATION_DYNAMIC_EUDEV
	help
	  script for USB device configure.

config BR2_PACKAGE_USB_MASS_STORAGE
	bool "usb mass storage config"
	depends on BR2_PACKAGE_USBDEVICE
	help
	  usb mass storage config
```

## package/rockchip/vendor_storage/Config.in
```kconfig
config BR2_PACKAGE_VENDOR_STORAGE
	bool "vendor storage tool for linux"
	help
	  vendor storage tool for linux. used to read/write vendor storage.
```

## package/sd-fuse-rk3399/Config.in
```kconfig
config BR2_PACKAGE_SD_FUSE_RK3399
        bool "sd_fuse-rk3399"
        help
          sd_fuse-rk3399 package for creating sdcards for rockchip 3399 boards

          https://github.com/friendlyarm/sd-fuse_rk3399
```
